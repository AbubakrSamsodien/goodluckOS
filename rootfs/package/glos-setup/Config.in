## rootfs/package/glos-setup/Config.in
```kconfig
config BR2_PACKAGE_GLOS_SETUP
	bool "glos-setup"
	depends on BR2_INSTALL_LIBSTDCPP
	select BR2_PACKAGE_SDL2
	select BR2_PACKAGE_SDL2_IMAGE
	select BR2_PACKAGE_IMGUI
	help
	  System Settings Application

comment "glos-setup needs a toolchain w/ C++"
	depends on !BR2_INSTALL_LIBSTDCPP
```
